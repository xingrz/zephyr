/*
 * Copyright (c) 2021 Nordic Semiconductor ASA
 *
 * SPDX-License-Identifier: Apache-2.0
 */

&zephyr_udc0 {
	cdc_acm_uart0 {
		compatible = "zephyr,cdc-acm-uart";
		label = "Zephyr USB CDC-ACM";

		gpio_uart: gpio-uart-line-control {
			compatible = "zephyr,gpio-uart-line-control";
			gpio-controller;
			#gpio-cells = <1>;
		};
	};
};
