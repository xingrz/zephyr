/*
 * Copyright (c) 2023 Chen Xingyu <hi@xingrz.me>
 * SPDX-License-Identifier: Apache-2.0
 */

#include <wch/ch58x/ch58x-common.dtsi>

/ {
	soc {
		uart2: uart@40003800 {
			compatible = "wch,ch5xx-uart";
			reg = <0x40003800 0x400>;
			interrupts = <CH58X_INT_UART2>;
			clocks = <&hclk CH58X_CLOCK_UART2>;
			status = "disabled";
		};

		uart3: uart@40003c00 {
			compatible = "wch,ch5xx-uart";
			reg = <0x40003c00 0x400>;
			interrupts = <CH58X_INT_UART3>;
			clocks = <&hclk CH58X_CLOCK_UART3>;
			status = "disabled";
		};
	};
};
