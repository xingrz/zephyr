## soc/riscv/luat/air101/Kconfig.series
```kconfig
# Copyright (c) 2023 Chen Xingyu <hi@xingrz.me>
# SPDX-License-Identifier: Apache-2.0

config SOC_SERIES_AIR101
	bool "Luat Air101 SoC"
	select RISCV
	select SOC_FAMILY_LUAT
	help
	  Enable support for Luat Air101 SoC.
```

## soc/riscv/luat/air101/Kconfig.soc
```kconfig
# Copyright (c) 2023 Chen Xingyu <hi@xingrz.me>
# SPDX-License-Identifier: Apache-2.0

choice
	prompt "Luat Air101"
	depends on SOC_SERIES_AIR101

config SOC_AIR101
	bool "Luat Air101"

endchoice
```

## soc/riscv/riscv-privilege/hi3861/Kconfig.defconfig.series
```kconfig
# Copyright (c) 2023 Chen Xingyu <hi@xingrz.me>
# SPDX-License-Identifier: Apache-2.0

if SOC_SERIES_HI3861

config SOC_SERIES
	default "hi3861"

config SYS_CLOCK_HW_CYCLES_PER_SEC
	default 24000000

config RISCV_SOC_INTERRUPT_INIT
	default y

config RISCV_HAS_CPU_IDLE
	default y

config RISCV_GP
	default y

config NUM_IRQS
	int
	default 62

config FLASH_LOAD_OFFSET
	default 0x2000
	help
	  The offset from the start of flash where the image is loaded.
	  At least 8KB should be reserved for the bootloader.

endif # SOC_SERIES_HI3861
```

## soc/riscv/riscv-privileged/sophgo/Kconfig.defconfig.cv180x
```kconfig
# Copyright (c) 2023-2024 Chen Xingyu <hi@xingrz.me>
# SPDX-License-Identifier: Apache-2.0

if SOC_CV180X

config SOC
	default "cv180x"

config SYS_CLOCK_HW_CYCLES_PER_SEC
	default 25000000

config NUM_IRQS
	int
	default 128

config RISCV_GP
	default y

config RISCV_SOC_INTERRUPT_INIT
	default y

config RISCV_HAS_PLIC
	default y

config PLIC_HAS_EDGE_TRIGGER
	default n

config 2ND_LVL_INTR_00_OFFSET
	default 11

endif # SOC_CV180X
```

## soc/riscv/riscv-privileged/sophgo/Kconfig.defconfig.series
```kconfig
# Copyright (c) 2023-2024 Chen Xingyu <hi@xingrz.me>
# SPDX-License-Identifier: Apache-2.0

if SOC_SERIES_SOPHGO

config SOC_SERIES
	default "sophgo"

rsource "Kconfig.defconfig.cv180x"

endif # SOC_SERIES_SOPHGO
```

## soc/riscv/riscv-privileged/sophgo/Kconfig.series
```kconfig
# Copyright (c) 2023-2024 Chen Xingyu <hi@xingrz.me>
# SPDX-License-Identifier: Apache-2.0

config SOC_SERIES_SOPHGO
	bool "SOPHGO RISC-V series"
	select RISCV
	select SOC_FAMILY_RISCV_PRIVILEGED
	select INCLUDE_RESET_VECTOR
	select ATOMIC_OPERATIONS_C
```

## soc/riscv/riscv-privileged/sophgo/Kconfig.soc
```kconfig
# Copyright (c) 2023-2024 Chen Xingyu <hi@xingrz.me>
# SPDX-License-Identifier: Apache-2.0

rsource "Kconfig.soc.cv180x"
```

## soc/riscv/riscv-privileged/sophgo/Kconfig.soc.cv180x
```kconfig
# Copyright (c) 2023-2024 Chen Xingyu <hi@xingrz.me>
# SPDX-License-Identifier: Apache-2.0

config SOC_CV180X
	bool "SOPHGO CV180x"
	depends on SOC_SERIES_SOPHGO
	select 64BIT
	select RISCV_ISA_RV64I
	select RISCV_ISA_EXT_M
	select RISCV_ISA_EXT_A
	select RISCV_ISA_EXT_F
	select RISCV_ISA_EXT_D
	select RISCV_ISA_EXT_C
	select RISCV_ISA_EXT_ZICSR
	select RISCV_ISA_EXT_ZIFENCEI
```

## soc/riscv/riscv-privileged/wch_ch32v/Kconfig.defconfig.ch58x
```kconfig
# Copyright (c) 2023 Chen Xingyu <hi@xingrz.me>
# SPDX-License-Identifier: Apache-2.0

if SOC_CH58X

config RISCV_HAS_CPU_IDLE
	default y

config NUM_IRQS
	int
	default 256

endif # SOC_CH58X
```

## soc/riscv/riscv-privileged/wch_ch32v/Kconfig.soc.ch57x
```kconfig
# Copyright (c) 2023 Chen Xingyu <hi@xingrz.me>
# SPDX-License-Identifier: Apache-2.0

config SOC_CH57X
	bool
	depends on SOC_SERIES_CH32V_QINGKE_V3A

config SOC_CH571
	bool "WCH CH571"
	select SOC_CH57X

config SOC_CH573
	bool "WCH CH573"
	select SOC_CH57X
```

## soc/riscv/riscv-privileged/wch_ch32v/Kconfig.soc.ch58x
```kconfig
# Copyright (c) 2023 Chen Xingyu <hi@xingrz.me>
# SPDX-License-Identifier: Apache-2.0

config SOC_CH58X
	bool
	depends on SOC_SERIES_CH32V_QINGKE_V4A

config SOC_CH581
	bool "WCH CH581"
	select SOC_CH58X

config SOC_CH582
	bool "WCH CH582"
	select SOC_CH58X

config SOC_CH583
	bool "WCH CH583"
	select SOC_CH58X
```

## soc/riscv/riscv-privileged/wch_ch32v/Kconfig.soc.ch59x
```kconfig
# Copyright (c) 2023 Chen Xingyu <hi@xingrz.me>
# SPDX-License-Identifier: Apache-2.0

config SOC_CH59X
	bool
	depends on SOC_SERIES_CH32V_QINGKE_V4A

config SOC_CH591
	bool "WCH CH591"
	select SOC_CH59X

config SOC_CH592
	bool "WCH CH592"
	select SOC_CH59X
```

## soc/wch/ch32v/qingke_v3/Kconfig.defconfig.ch57x
```kconfig
# Copyright (c) 2023-2024 Chen Xingyu <hi@xingrz.me>
# SPDX-License-Identifier: Apache-2.0

if SOC_CH57X

config NUM_IRQS
	int
	default 35

config SYS_CLOCK_HW_CYCLES_PER_SEC
	default $(dt_node_int_prop_int,$(dt_nodelabel_path,hclk),clock-frequency)

config CLOCK_CONTROL
	default y

config GPIO
	default y

config PINCTRL
	default y

endif # SOC_CH57X
```

## soc/wch/ch32v/qingke_v3/Kconfig.soc.ch57x
```kconfig
# Copyright (c) 2023-2024 Chen Xingyu <hi@xingrz.me>
# SPDX-License-Identifier: Apache-2.0

config SOC_CH57X
	bool
	select SOC_SERIES_CH32V_QINGKE_V3A

config SOC_CH571
	bool "WCH CH571"
	select SOC_CH57X

config SOC_CH573
	bool "WCH CH573"
	select SOC_CH57X

config SOC
	default "ch571" if SOC_CH571
	default "ch573" if SOC_CH573
```

## soc/wch/ch32v/qingke_v4/Kconfig.defconfig.ch58x
```kconfig
# Copyright (c) 2023-2024 Chen Xingyu <hi@xingrz.me>
# SPDX-License-Identifier: Apache-2.0

if SOC_CH58X

config NUM_IRQS
	int
	default 35

endif # SOC_CH58X
```

## soc/wch/ch32v/qingke_v4/Kconfig.soc
```kconfig
# Copyright (c) 2023-2024 Chen Xingyu <hi@xingrz.me>
# SPDX-License-Identifier: Apache-2.0

config SOC_SERIES_CH32V_QINGKE_V4A
	bool
	select SOC_FAMILY_CH32V

config SOC_SERIES
	default "qingke_v4" if SOC_SERIES_CH32V_QINGKE_V4A

rsource "Kconfig.soc.*"
```

## soc/wch/ch32v/qingke_v4/Kconfig.soc.ch58x
```kconfig
# Copyright (c) 2023-2024 Chen Xingyu <hi@xingrz.me>
# SPDX-License-Identifier: Apache-2.0

config SOC_CH58X
	bool
	select SOC_SERIES_CH32V_QINGKE_V4A

config SOC_CH581
	bool "WCH CH581"
	select SOC_CH58X

config SOC_CH582
	bool "WCH CH582"
	select SOC_CH58X

config SOC_CH583
	bool "WCH CH583"
	select SOC_CH58X

config SOC
	default "ch581" if SOC_CH581
	default "ch582" if SOC_CH582
	default "ch583" if SOC_CH583
```

## tests/drivers/i2c/i2c_api/boards/rpi_4b.conf
```kconfig
# Copyright (c) 2023 Chen Xingyu <hi@xingrz.me>
# SPDX-License-Identifier: Apache-2.0

CONFIG_CLOCK_CONTROL=y
CONFIG_PINCTRL=y
```
