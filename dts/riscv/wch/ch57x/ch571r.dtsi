/*
 * Copyright (c) 2023 Chen Xingyu <hi@xingrz.me>
 * SPDX-License-Identifier: Apache-2.0
 */

#include <wch/ch57x/ch57x-common.dtsi>
#include <wch/ch57x/ch571-common.dtsi>

/ {
	soc {
		compatible = "wch,ch571r";
	};
};
