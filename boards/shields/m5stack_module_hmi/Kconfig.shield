## boards/shields/m5stack_module_hmi/Kconfig.shield
```kconfig
# Copyright (c) 2025 Chen Xingyu <hi@xingrz.me>
# SPDX-License-Identifier: Apache-2.0

config SHIELD_M5STACK_MODULE_HMI
	def_bool $(shields_list_contains,m5stack_module_hmi)
	select MFD
```

## boards/shields/m5stack_unit_extio2/Kconfig.shield
```kconfig
# Copyright (c) 2025 Chen Xingyu <hi@xingrz.me>
# SPDX-License-Identifier: Apache-2.0

config SHIELD_M5STACK_UNIT_EXTIO2
	def_bool $(shields_list_contains,m5stack_unit_extio2)
	select MFD
```

## drivers/gpio/Kconfig.m5stack
```kconfig
# Copyright (c) 2025 Chen Xingyu <hi@xingrz.me>
# SPDX-License-Identifier: Apache-2.0

config GPIO_M5_EXPANSION
	bool "M5Stack expansion GPIO driver"
	default y
	depends on DT_HAS_M5STACK_EXPANSION_GPIO_ENABLED
	depends on DT_HAS_M5STACK_GROVE_PORTA_ENABLED || DT_HAS_M5STACK_MBUS_ENABLED
	select I2C
	help
	  Enable the M5Stack expansion GPIO driver

config GPIO_M5_EXPANSION_INIT_PRIORITY
	int "Initialization priority for M5Stack expansion GPIO drivers"
	default 92
	help
	  Initialization priority for M5Stack expansion GPIO device drivers.

	  This priority must be greater than that of the M5Stack expansion MFDs
	  to ensure proper initialization ordering.
```

## drivers/gpio/Kconfig.uart_line_control
```kconfig
# Copyright (c) 2025 Chen Xingyu <hi@xingrz.me>
# SPDX-License-Identifier: Apache-2.0

config GPIO_UART_LINE_CONTROL
	bool "USB UART control lines as GPIOs"
	default y
	depends on DT_HAS_ZEPHYR_GPIO_UART_LINE_CONTROL_ENABLED
	depends on SERIAL
	select UART_LINE_CTRL
	help
	  Enable the GPIO driver which exposes the control lines of a UART device
```

## drivers/input/Kconfig.m5stack
```kconfig
# Copyright (c) 2025 Chen Xingyu <hi@xingrz.me>
# SPDX-License-Identifier: Apache-2.0

config INPUT_M5_EXPANSION_KEY
	bool "M5Stack expansion key input driver"
	default y
	depends on DT_HAS_M5STACK_EXPANSION_KEY_INPUT_ENABLED
	depends on DT_HAS_M5STACK_GROVE_PORTA_ENABLED || DT_HAS_M5STACK_MBUS_ENABLED
	select I2C
	help
	  Enable the M5Stack expansion key input driver

config INPUT_M5_EXPANSION_ROTARY
	bool "M5Stack expansion rotary input driver"
	default y
	depends on DT_HAS_M5STACK_EXPANSION_ROTARY_INPUT_ENABLED
	depends on DT_HAS_M5STACK_GROVE_PORTA_ENABLED || DT_HAS_M5STACK_MBUS_ENABLED
	select I2C
	help
	  Enable the M5Stack expansion rotary input driver

config INPUT_M5_EXPANSION_INIT_PRIORITY
	int "Initialization priority for M5Stack expansion input drivers"
	default 91
	help
	  Initialization priority for M5Stack expansion input device drivers.

	  This priority must be greater than that of the M5Stack expansion MFDs
	  to ensure proper initialization ordering.
```

## drivers/led_strip/Kconfig.m5stack
```kconfig
# Copyright (c) 2025 Chen Xingyu <hi@xingrz.me>
# SPDX-License-Identifier: Apache-2.0

config LED_STRIP_M5_EXPANSION
	bool "M5Stack expansion LED strip driver"
	default y
	depends on DT_HAS_M5STACK_EXPANSION_LED_STRIP_ENABLED
	depends on DT_HAS_M5STACK_GROVE_PORTA_ENABLED || DT_HAS_M5STACK_MBUS_ENABLED
	select I2C
	help
	  Enable the M5Stack expansion LED strip driver

config LED_STRIP_M5_EXPANSION_INIT_PRIORITY
	int "Initialization priority for M5Stack expansion LED strip drivers"
	default 92
	help
	  Initialization priority for M5Stack expansion LED strip device drivers.

	  This priority must be greater than that of the M5Stack expansion MFDs
	  to ensure proper initialization ordering.
```

## drivers/mfd/Kconfig.m5stack
```kconfig
# Copyright (c) 2025 Chen Xingyu <hi@xingrz.me>
# SPDX-License-Identifier: Apache-2.0

config MFD_M5_EXPANSION
	bool "MFD driver for M5Stack PORT.A/M-bus I2C expansions"
	default y
	depends on DT_HAS_M5STACK_GROVE_PORTA_ENABLED || \
		   DT_HAS_M5STACK_MBUS_ENABLED
	select I2C
	help
	  Enable the M5Stack PORT.A/M-bus I2C multi-function device driver

config MFD_M5_EXPANSION_INIT_PRIORITY
	int "Initialization priority for M5Stack PORT.A/M-bus I2C MFD drivers"
	default 90
	help
	  Initialization priority for M5Stack PORT.A/M-bus I2C multi-function
	  device drivers.

	  This priority must be greater than that of the I2C bus and any
	  regulators these devices depend on.
```

## drivers/sensor/qst/Kconfig
```kconfig
# Copyright (c) 2025 Chen Xingyu <hi@xingrz.me>
# SPDX-License-Identifier: Apache-2.0

# zephyr-keep-sorted-start
source "drivers/sensor/qst/qmi8658/Kconfig"
# zephyr-keep-sorted-stop
```

## drivers/sensor/qst/qmi8658/Kconfig
```kconfig
# Copyright (c) 2025 Chen Xingyu <hi@xingrz.me>
# SPDX-License-Identifier: Apache-2.0

config QMI8658
	bool "QST QMI8658 6-axis IMU sensor driver"
	default y
	depends on DT_HAS_QST_QMI8658_ENABLED
	select I2C if $(dt_compat_on_bus,$(DT_COMPAT_QST_QMI8658),i2c)
	help
	  Enable the QST QMI8658 6-axis IMU sensor driver
```

## dts/bindings/gpio/m5stack,expansion-gpio.yaml
```yaml
# Copyright (c) 2025 Chen Xingyu <hi@xingrz.me>
# SPDX-License-Identifier: Apache-2.0

description: M5Stack expansion GPIO

compatible: m5stack,expansion-gpio

include: [gpio-controller.yaml, base.yaml]

properties:
  reg:
    required: true

  reg-names:
    required: true

  "#gpio-cells":
    const: 2

gpio-cells:
  - pin
  - flags
```

## dts/bindings/gpio/m5stack,unit-extio2-gpio.yaml
```yaml
# Copyright (c) 2025 Chen Xingyu <hi@xingrz.me>
# SPDX-License-Identifier: Apache-2.0

description: M5Stack Unit EXT.IO2 GPIO

compatible: m5stack,unit-extio2-gpio

include: [gpio-controller.yaml, base.yaml]

on-bus: unit-extio2

properties:
  "#gpio-cells":
    const: 2

gpio-cells:
  - pin
  - flags
```

## dts/bindings/gpio/zephyr,gpio-uart-line-control.yaml
```yaml
# Copyright (c) 2025 Chen Xingyu <hi@xingrz.me>
# SPDX-License-Identifier: Apache-2.0

description: |
  USB UART control lines as GPIOs

  This driver exposes the control lines of a USB UART device as GPIOs.

  Example usage:

      &zephyr_udc0 {
      	cdc_acm_uart0 {
      		compatible = "zephyr,cdc-acm-uart";

      		gpio_uart: gpio-uart-line-control {
      			compatible = "zephyr,gpio-uart-line-control";
      		};
      	};
      };

compatible: "zephyr,gpio-uart-line-control"

include: [gpio-controller.yaml, base.yaml]

on-bus: uart

properties:
  "#gpio-cells":
    const: 1

gpio-cells:
  - pin
```

## dts/bindings/input/m5stack,expansion-key-input.yaml
```yaml
# Copyright (c) 2025 Chen Xingyu <hi@xingrz.me>
# SPDX-License-Identifier: Apache-2.0

description: M5Stack expansion key input

compatible: m5stack,expansion-key-input

include: base.yaml

properties:
  reg:
    required: true

  "#address-cells":
    const: 1
  "#size-cells":
    const: 0

  poll-interval-ms:
    type: int
    default: 100
    description: |
      Polling interval in milliseconds. If not specified defaults to 100.

child-binding:
  description: Input button configuration
  properties:
    reg:
      type: int
      required: true
      description: Button index starting from 0

    zephyr,code:
      type: int
      required: true
      description: Key code as defined in input-event-codes.h
```

## dts/bindings/input/m5stack,expansion-rotary-input.yaml
```yaml
# Copyright (c) 2025 Chen Xingyu <hi@xingrz.me>
# SPDX-License-Identifier: Apache-2.0

description: M5Stack expansion rotary input

compatible: m5stack,expansion-rotary-input

include: base.yaml

properties:
  reg:
    required: true

  reg-names:
    required: true

  poll-interval-ms:
    type: int
    default: 100
    description: |
      Polling interval in milliseconds. If not specified defaults to 100.

  zephyr,axis:
    type: int
    required: true
    description: |
      The input code for the axis to report for the device, typically any of
      INPUT_REL_*.
```

## dts/bindings/input/m5stack,unit-bytebutton-input.yaml
```yaml
# Copyright (c) 2025 Chen Xingyu <hi@xingrz.me>
# SPDX-License-Identifier: Apache-2.0

description: M5Stack Unit ByteButton input

compatible: m5stack,unit-bytebutton-input

include: base.yaml

on-bus: unit-bytebutton

properties:
  "#address-cells":
    const: 1
  "#size-cells":
    const: 0

  poll-interval-ms:
    type: int
    default: 100
    description: |
      Polling interval in milliseconds. If not specified defaults to 100.

child-binding:
  description: Input button configuration
  properties:
    reg:
      type: int
      required: true
      description: Button index starting from 0

    label:
      type: string
      description: Descriptive name of the key

    zephyr,code:
      type: int
      required: true
      description: Key code as defined in input-event-codes.h
```

## dts/bindings/input/m5stack,unit-byteswitch-input.yaml
```yaml
# Copyright (c) 2025 Chen Xingyu <hi@xingrz.me>
# SPDX-License-Identifier: Apache-2.0

description: M5Stack Unit ByteSwitch input

compatible: m5stack,unit-byteswitch-input

include: m5stack,unit-bytebutton-input.yaml
```

## dts/bindings/led_strip/m5stack,expansion-led-strip.yaml
```yaml
# Copyright (c) 2025 Chen Xingyu <hi@xingrz.me>
# SPDX-License-Identifier: Apache-2.0

description: M5Stack expansion LED strip

compatible: m5stack,expansion-led-strip

include: [led-strip.yaml, base.yaml]

properties:
  reg:
    required: true

  reg-names:
    required: true

  pixel-stride:
    type: int
    description: Number of bytes per pixel
    default: 3

  pixel-offset:
    type: int
    description: Offset of the first pixel data byte within a pixel
    default: 0
```

## dts/bindings/led_strip/m5stack,unit-bytebutton-led-strip.yaml
```yaml
# Copyright (c) 2025 Chen Xingyu <hi@xingrz.me>
# SPDX-License-Identifier: Apache-2.0

description: M5Stack Unit ByteButton LED strip

compatible: m5stack,unit-bytebutton-led-strip

include: led-strip.yaml

on-bus: unit-bytebutton

properties:
  chain-length:
    const: 9
```

## dts/bindings/led_strip/m5stack,unit-byteswitch-led-strip.yaml
```yaml
# Copyright (c) 2025 Chen Xingyu <hi@xingrz.me>
# SPDX-License-Identifier: Apache-2.0

description: M5Stack Unit ByteSwitch LED strip

compatible: m5stack,unit-byteswitch-led-strip

include: m5stack,unit-bytebutton-led-strip.yaml
```

## dts/bindings/mfd/m5stack,grove-porta.yaml
```yaml
# Copyright (c) 2025 Chen Xingyu <hi@xingrz.me>
# SPDX-License-Identifier: Apache-2.0

description: M5Stack Grove PORT.A expansion

compatible: m5stack,grove-porta

include: m5stack,expansion.yaml
```

## dts/bindings/mfd/m5stack,mbus.yaml
```yaml
# Copyright (c) 2025 Chen Xingyu <hi@xingrz.me>
# SPDX-License-Identifier: Apache-2.0

description: M5Stack M-Bus expansion

compatible: m5stack,mbus

include: m5stack,expansion.yaml
```

## dts/bindings/mfd/m5stack,module-hmi.yaml
```yaml
# Copyright (c) 2025 Chen Xingyu <hi@xingrz.me>
# SPDX-License-Identifier: Apache-2.0

description: M5Stack Module HMI

compatible: m5stack,module-hmi

include: i2c-device.yaml

bus: module-hmi

properties:
  reg:
    required: true
```

## dts/bindings/mfd/m5stack,unit-bytebutton.yaml
```yaml
# Copyright (c) 2025 Chen Xingyu <hi@xingrz.me>
# SPDX-License-Identifier: Apache-2.0

description: M5Stack Unit ByteButton

compatible: m5stack,unit-bytebutton

include: i2c-device.yaml

bus: unit-bytebutton

properties:
  reg:
    required: true
```

## dts/bindings/mfd/m5stack,unit-byteswitch.yaml
```yaml
# Copyright (c) 2025 Chen Xingyu <hi@xingrz.me>
# SPDX-License-Identifier: Apache-2.0

description: M5Stack Unit ByteSwitch

compatible: m5stack,unit-byteswitch

include: m5stack,unit-bytebutton.yaml
```
