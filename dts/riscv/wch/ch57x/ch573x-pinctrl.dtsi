/*
 * Copyright (c) 2023 Chen Xingyu <hi@xingrz.me>
 * SPDX-License-Identifier: Apache-2.0
 */

#include <wch/ch57x/ch57x-common-pinctrl.dtsi>
#include <wch/ch57x/ch573-common-pinctrl.dtsi>
#include <wch/ch57x/ch573(xq)-common-pinctrl.dtsi>
