/*
 * Copyright (c) 2023 Chen Xingyu <hi@xingrz.me>
 * SPDX-License-Identifier: Apache-2.0
 */

/dts-v1/;
#include <arm/luat/air101.dtsi>
#include <zephyr/dt-bindings/gpio/gpio.h>

/ {
	model = "Luat CORE-Air101";
	compatible = "luat,core-air101";
};
