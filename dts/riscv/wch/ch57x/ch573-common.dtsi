/*
 * Copyright (c) 2023-2024 Chen Xingyu <hi@xingrz.me>
 * SPDX-License-Identifier: Apache-2.0
 */

#include <wch/ch57x/ch57x-common.dtsi>

/ {
	soc {
		uart2: uart@40003800 {
			compatible = "wch,ch5xx-uart";
			reg = <0x40003800 0x400>;
			interrupts = <33 19>;
			clocks = <&hclk>;
			status = "disabled";
		};

		uart3: uart@40003c00 {
			compatible = "wch,ch5xx-uart";
			reg = <0x40003c00 0x400>;
			interrupts = <34 20>;
			clocks = <&hclk>;
			status = "disabled";
		};
	};
};
