## dts/bindings/mfd/m5stack,unit-extio2.yaml
```yaml
# Copyright (c) 2025 Chen Xingyu <hi@xingrz.me>
# SPDX-License-Identifier: Apache-2.0

description: M5Stack Unit EXT.IO2

compatible: m5stack,unit-extio2

include: i2c-device.yaml

bus: unit-extio2

properties:
  reg:
    required: true
```

## dts/bindings/sensor/qst,qmi8658-common.yaml
```yaml
# Copyright (c) 2025 Chen Xingyu <hi@xingrz.me>
# SPDX-License-Identifier: Apache-2.0

description: QST QMI8658 6-axis IMU sensor

compatible: qst,qmi8658

include: sensor-device.yaml

properties:
  int1-gpios:
    type: phandle-array
    description: GPIO connected to INT1 pin of the sensor

  int2-gpios:
    type: phandle-array
    description: GPIO connected to INT2 pin of the sensor
```

## dts/bindings/sensor/qst,qmi8658-i2c.yaml
```yaml
# Copyright (c) 2025 Chen Xingyu <hi@xingrz.me>
# SPDX-License-Identifier: Apache-2.0

description: QST QMI8658 6-axis IMU sensor on I2C bus

compatible: qst,qmi8658

include: ["i2c-device.yaml", "qst,qmi8658-common.yaml"]
```
