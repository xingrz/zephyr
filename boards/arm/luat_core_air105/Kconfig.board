## boards/arm/luat_core_air105/Kconfig.board
```kconfig
# Copyright (c) 2023 Chen Xingyu <hi@xingrz.me>
# SPDX-License-Identifier: Apache-2.0

config BOARD_LUAT_CORE_AIR105
	bool "Luat CORE-Air105"
	depends on SOC_AIR105
```

## boards/arm/luat_core_air105/Kconfig.defconfig
```kconfig
# Copyright (c) 2023 Chen Xingyu <hi@xingrz.me>
# SPDX-License-Identifier: Apache-2.0

if BOARD_LUAT_CORE_AIR105

config BOARD
	default "luat_core_air105"

endif # BOARD_LUAT_CORE_AIR105
```

## boards/arm/luat_core_air105/luat_core_air105_defconfig
```kconfig
# Copyright (c) 2023 Chen Xingyu <hi@xingrz.me>
# SPDX-License-Identifier: Apache-2.0

CONFIG_SOC_SERIES_AIR105=y
CONFIG_SOC_AIR105=y
CONFIG_BOARD_LUAT_CORE_AIR105=y

CONFIG_PINCTRL=y
CONFIG_SERIAL=y

CONFIG_CONSOLE=y
CONFIG_UART_CONSOLE=y
```

## boards/riscv/ch573f_evt/Kconfig.board
```kconfig
# Copyright (c) 2023 Chen Xingyu <hi@xingrz.me>
# SPDX-License-Identifier: Apache-2.0

config BOARD_CH573F_EVT
	bool "WCH CH573F-EVT"
	depends on SOC_CH573
```

## boards/riscv/ch573f_evt/Kconfig.defconfig
```kconfig
# Copyright (c) 2023 Chen Xingyu <hi@xingrz.me>
# SPDX-License-Identifier: Apache-2.0

if BOARD_CH573F_EVT

config BOARD
	default "ch573f_evt"

endif # BOARD_CH573F_EVT
```

## boards/riscv/ch573f_evt/ch573f_evt_defconfig
```kconfig
# Copyright (c) 2023 Chen Xingyu <hi@xingrz.me>
# SPDX-License-Identifier: Apache-2.0

CONFIG_SOC_SERIES_CH32V_QINGKE_V3A=y
CONFIG_SOC_CH573=y
CONFIG_BOARD_CH573F_EVT=y
CONFIG_SERIAL=y
CONFIG_CONSOLE=y
CONFIG_UART_CONSOLE=y
```

## boards/riscv/ch582m_evt/Kconfig.board
```kconfig
# Copyright (c) 2023 Chen Xingyu <hi@xingrz.me>
# SPDX-License-Identifier: Apache-2.0

config BOARD_CH582M_EVT
	bool "WCH CH582M-EVT"
	depends on SOC_CH582
```

## boards/riscv/ch582m_evt/Kconfig.defconfig
```kconfig
# Copyright (c) 2023 Chen Xingyu <hi@xingrz.me>
# SPDX-License-Identifier: Apache-2.0

if BOARD_CH582M_EVT

config BOARD
	default "ch582m_evt"

endif # BOARD_CH582M_EVT
```

## boards/riscv/ch582m_evt/ch582m_evt_defconfig
```kconfig
# Copyright (c) 2023 Chen Xingyu <hi@xingrz.me>
# SPDX-License-Identifier: Apache-2.0

CONFIG_SOC_SERIES_CH32V_QINGKE_V4A=y
CONFIG_SOC_CH582=y
CONFIG_BOARD_CH582M_EVT=y
CONFIG_SERIAL=y
CONFIG_CONSOLE=y
CONFIG_UART_CONSOLE=y
```

## boards/riscv/ch583m_evt/Kconfig.board
```kconfig
# Copyright (c) 2023 Chen Xingyu <hi@xingrz.me>
# SPDX-License-Identifier: Apache-2.0

config BOARD_CH583M_EVT
	bool "WCH CH583M-EVT"
	depends on SOC_CH583
```

## boards/riscv/ch583m_evt/Kconfig.defconfig
```kconfig
# Copyright (c) 2023 Chen Xingyu <hi@xingrz.me>
# SPDX-License-Identifier: Apache-2.0

if BOARD_CH583M_EVT

config BOARD
	default "ch583m_evt"

endif # BOARD_CH583M_EVT
```

## boards/riscv/ch583m_evt/ch583m_evt_defconfig
```kconfig
# Copyright (c) 2023 Chen Xingyu <hi@xingrz.me>
# SPDX-License-Identifier: Apache-2.0

CONFIG_SOC_SERIES_CH32V_QINGKE_V4A=y
CONFIG_SOC_CH583=y
CONFIG_BOARD_CH583M_EVT=y
CONFIG_SERIAL=y
CONFIG_CONSOLE=y
CONFIG_UART_CONSOLE=y
```

## boards/riscv/ch592f_evt/Kconfig.board
```kconfig
# Copyright (c) 2023 Chen Xingyu <hi@xingrz.me>
# SPDX-License-Identifier: Apache-2.0

config BOARD_CH592F_EVT
	bool "WCH CH592F-EVT"
	depends on SOC_CH592
```

## boards/riscv/ch592f_evt/Kconfig.defconfig
```kconfig
# Copyright (c) 2023 Chen Xingyu <hi@xingrz.me>
# SPDX-License-Identifier: Apache-2.0

if BOARD_CH592F_EVT

config BOARD
	default "ch592f_evt"

endif # BOARD_CH592F_EVT
```

## boards/riscv/luat_core_air101/Kconfig.board
```kconfig
# Copyright (c) 2023 Chen Xingyu <hi@xingrz.me>
# SPDX-License-Identifier: Apache-2.0

config BOARD_LUAT_CORE_AIR101
	bool "Luat CORE-Air101"
	depends on SOC_AIR101
```

## boards/riscv/luat_core_air101/Kconfig.defconfig
```kconfig
# Copyright (c) 2023 Chen Xingyu <hi@xingrz.me>
# SPDX-License-Identifier: Apache-2.0

if BOARD_LUAT_CORE_AIR101

config BOARD
	default "luat_core_air101"

endif # BOARD_LUAT_CORE_AIR101
```

## boards/riscv/luat_core_air101/luat_core_air101_defconfig
```kconfig
# Copyright (c) 2023 Chen Xingyu <hi@xingrz.me>
# SPDX-License-Identifier: Apache-2.0

CONFIG_SOC_SERIES_AIR101=y
CONFIG_SOC_AIR101=y
CONFIG_BOARD_LUAT_CORE_AIR101=y
```

## boards/riscv/milkv_duo/Kconfig.board
```kconfig
# Copyright (c) 2023-2024 Chen Xingyu <hi@xingrz.me>
# SPDX-License-Identifier: Apache-2.0

config BOARD_MILKV_DUO
	bool "Milk-V Duo"
	depends on SOC_CV180X
```

## boards/riscv/milkv_duo/Kconfig.defconfig
```kconfig
# Copyright (c) 2023-2024 Chen Xingyu <hi@xingrz.me>
# SPDX-License-Identifier: Apache-2.0

if BOARD_MILKV_DUO

config BOARD
	default "milkv_duo"

endif # BOARD_MILKV_DUO
```

## boards/riscv/milkv_duo/milkv_duo_defconfig
```kconfig
# Copyright (c) 2023-2024 Chen Xingyu <hi@xingrz.me>
# SPDX-License-Identifier: Apache-2.0

CONFIG_SOC_SERIES_SOPHGO=y
CONFIG_SOC_CV180X=y
CONFIG_BOARD_MILKV_DUO=y

CONFIG_XIP=n

CONFIG_PINCTRL=y
CONFIG_SERIAL=y

CONFIG_CONSOLE=y
CONFIG_UART_CONSOLE=y
```

## boards/sipeed/licheerv_nano/Kconfig.licheerv_nano
```kconfig
# Copyright (c) 2024 Chen Xingyu <hi@xingrz.me>
# SPDX-License-Identifier: Apache-2.0

config BOARD_LICHEERV_NANO
	select SOC_SG2002
```

## boards/waveshare/esp32s3_matrix/esp32s3_matrix_esp32s3_procpu_defconfig
```kconfig
# Copyright (c) 2024 Joel Guittet
# Copyright (c) 2025 Chen Xingyu <hi@xingrz.me>
# SPDX-License-Identifier: Apache-2.0

CONFIG_MAIN_STACK_SIZE=2048
CONFIG_GPIO=y
CONFIG_CONSOLE=y
CONFIG_SERIAL=y
CONFIG_UART_CONSOLE=y
CONFIG_CLOCK_CONTROL=y
CONFIG_INPUT=y
CONFIG_LED_STRIP=y
```

## boards/wch/ch582m_evt/Kconfig.ch582m_evt
```kconfig
# Copyright (c) 2023-2024 Chen Xingyu <hi@xingrz.me>
# SPDX-License-Identifier: Apache-2.0

config BOARD_CH582M_EVT
	select SOC_CH582
```
