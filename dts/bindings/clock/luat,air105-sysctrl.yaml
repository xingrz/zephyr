## dts/bindings/clock/luat,air105-sysctrl.yaml
```yaml
# Copyright (c) 2023 Chen Xingyu <hi@xingrz.me>
# SPDX-License-Identifier: Apache-2.0

description: Clock controller for Luat Air105

compatible: "luat,air105-sysctrl"

include: [clock-controller.yaml, base.yaml]

properties:
  reg:
    required: true

  clock-source:
    required: true
    type: string
    description: |
      The clock source for the system clock. Valid values are:
        - "xtal12m": External 12MHz crystal
        - "osc12m": Internal 12MHz RC oscillator
    enum:
      - "xtal12m"
      - "osc12m"

  clock-frequency:
    required: true
    type: int
    description: |
      The frequency of the system clock. Valid values are:
        - 108000000, 108 MHz
        - 120000000, 120 MHz
        - 132000000, 132 MHz
        - 144000000, 144 MHz
        - 156000000, 156 MHz
        - 168000000, 168 MHz
        - 180000000, 180 MHz
        - 192000000, 192 MHz
        - 204000000, 204 MHz
    enum:
      - 108000000
      - 120000000
      - 132000000
      - 144000000
      - 156000000
      - 168000000
      - 180000000
      - 192000000
      - 204000000

  pll-divider:
    required: true
    type: int
    description: |
      The divider of the PLL clock of which output is FCLK. Valid values are:
        - 0: FCLK = PLL_FREQ
        - 2: FCLK = PLL_FREQ / 2
        - 4: FCLK = PLL_FREQ / 4
    enum:
      - 0
      - 2
      - 4

  hclk-divider:
    required: true
    type: int
    description: |
      The divider of the FCLK clock of which output is HCLK. Valid values are:
        - 0: HCLK = FCLK (for FCLK <= 102 MHz)
        - 2: HCLK = FCLK / 2
    enum:
      - 0
      - 2

  pclk-divider:
    required: true
    type: int
    description: |
      The divider of the HCLK clock of which output is PCLK. Valid values are:
        - 2: PCLK = HCLK / 2
        - 4: PCLK = HCLK / 4
    enum:
      - 2
      - 4

  "#clock-cells":
    const: 2

clock-cells:
  - clock-type
  - clock-gate
```

## dts/bindings/clock/wch,ch57x-clkmux.yaml
```yaml
# Copyright (c) 2023 Chen Xingyu <hi@xingrz.me>
# SPDX-License-Identifier: Apache-2.0

description: WCH CH57x clock mux controller

compatible: "wch,ch57x-clkmux"

include: [clock-controller.yaml, base.yaml]

properties:
  clock-frequency:
    type: int
    description: |
      System clock frequency in Hz. Supported values are:
        - DT_FREQ_M(1)
        - DT_FREQ_M(2)
        - DT_FREQ_M(4)
        - DT_FREQ_K(6400)
        - DT_FREQ_M(8)
        - DT_FREQ_M(15)
        - DT_FREQ_M(16)
        - DT_FREQ_M(20)
        - DT_FREQ_M(24)
        - DT_FREQ_M(30)
        - DT_FREQ_M(32)
        - DT_FREQ_K(36900)
        - DT_FREQ_M(40)
        - DT_FREQ_M(48)
        - DT_FREQ_M(60)
        - DT_FREQ_M(80)
    enum:
      - 1000000
      - 2000000
      - 4000000
      - 6400000
      - 8000000
      - 15000000
      - 16000000
      - 20000000
      - 24000000
      - 30000000
      - 32000000
      - 36900000
      - 40000000
      - 48000000
      - 60000000
      - 80000000

  "#clock-cells":
    const: 0
```

## dts/bindings/clock/wch,ch59x-clkmux.yaml
```yaml
# Copyright (c) 2023 Chen Xingyu <hi@xingrz.me>
# SPDX-License-Identifier: Apache-2.0

description: WCH CH59x clock mux controller

compatible: "wch,ch59x-clkmux"

include: [clock-controller.yaml, base.yaml]

properties:
  clock-frequency:
    type: int
    description: |
      System clock frequency in Hz. Supported values are:
        - DT_FREQ_M(4)
        - DT_FREQ_K(6400)
        - DT_FREQ_M(8)
        - DT_FREQ_M(16)
        - DT_FREQ_M(24)
        - DT_FREQ_M(32)
        - DT_FREQ_M(48)
        - DT_FREQ_M(60)
    enum:
      - 4000000
      - 6400000
      - 8000000
      - 16000000
      - 24000000
      - 32000000
      - 48000000
      - 60000000

  "#clock-cells":
    const: 0
```

## dts/bindings/clock/wch,ch5xx-hclk.yaml
```yaml
# Copyright (c) 2023 Chen Xingyu <hi@xingrz.me>
# SPDX-License-Identifier: Apache-2.0

description: WCH CH5xx HCLK clock controller

compatible: "wch,ch5xx-hclk"

include: [clock-controller.yaml, base.yaml]

properties:
  clocks:
    required: true

  "#clock-cells":
    const: 2

clock-cells:
  - offset
  - bit
```

## dts/bindings/cpu/wch,qingke-v4.yaml
```yaml
# Copyright (c) 2023 Chen Xingyu <hi@xingrz.me>
# SPDX-License-Identifier: Apache-2.0

description: WCH QingKe V4 RISC-V CPU

compatible: "wch,qingke-v4"

include: cpu.yaml
```

## dts/bindings/flash_controller/hisilicon,hi3861-flash-controller.yaml
```yaml
# Copyright (c) 2023 Chen Xingyu <hi@xingrz.me>
# SPDX-License-Identifier: Apache-2.0

description: Hi3861 SPI Flash Controller (SFC)

compatible: "hisilicon,hi3861-flash-controller"

include: flash-controller.yaml
```

## dts/bindings/flash_controller/luat,air105-flash-controller.yaml
```yaml
# Copyright (c) 2023 Chen Xingyu <hi@xingrz.me>
# SPDX-License-Identifier: Apache-2.0

description: Flash controller for Luat Air105

compatible: "luat,air105-flash-controller"

include: flash-controller.yaml
```

## dts/bindings/i2c/brcm,bcm2711-i2c.yaml
```yaml
# Copyright (c) 2023 Chen Xingyu <hi@xingrz.me>
# SPDX-License-Identifier: Apache-2.0

description: BCM2711 I2C

compatible: "brcm,bcm2711-i2c"

include: [i2c-controller.yaml, pinctrl-device.yaml, base.yaml]

properties:
  reg:
    required: true

  interrupts:
    required: true

  clocks:
    required: true
```

## dts/bindings/led/skyworks,aat3194.yaml
```yaml
# Copyright (c) 2023 Chen Xingyu <hi@xingrz.me>
# SPDX-License-Identifier: Apache-2.0

description: Skyworks AAT3194 LED driver

compatible: "skyworks,aat3194"

include: base.yaml

properties:
  output-gpios:
    type: phandle-array
    required: true

  steps:
    type: int
    default: 32
    description: Number of steps in the LED brightness ramp.

  decreasing:
    type: boolean
    description: |
      If enabled the LED brightness ramp is decreasing. Increasing else.
```

## dts/bindings/pinctrl/brcm,bcm2711-pinctrl.yaml
```yaml
# Copyright (c) 2023 Chen Xingyu <hi@xingrz.me>
# SPDX-License-Identifier: Apache-2.0

description: BCM2711 Pin Controller

compatible: "brcm,bcm2711-pinctrl"

include: base.yaml

child-binding:
  description: BCM2711 pinmux group

  child-binding:
    properties:
      pinmux:
        required: true
        type: array
```

## dts/bindings/pinctrl/luat,air105-pinctrl.yaml
```yaml
# Copyright (c) 2023 Chen Xingyu <hi@xingrz.me>
# SPDX-License-Identifier: Apache-2.0

description: Pin controller for Luat Air105

compatible: "luat,air105-pinctrl"

include: base.yaml

properties:
  "#address-cells":
    required: true
    const: 1
  "#size-cells":
    required: true
    const: 1

child-binding:
  description: Air105 pin controller pin group

  child-binding:
    include:
      - name: pincfg-node.yaml
        property-allowlist:
          - bias-disable
          - bias-pull-up

    properties:
      pinmux:
        required: true
        type: array
```

## dts/bindings/pinctrl/sophgo,cv180x-pinctrl.yaml
```yaml
# Copyright (c) 2023-2024Z Chen Xingyu <hi@xingrz.me>
# SPDX-License-Identifier: Apache-2.0

description: SOPHGO CV180x pin controller driver

compatible: "sophgo,cv180x-pinctrl"

include: base.yaml

child-binding:
  description: CV180x pinmux group

  child-binding:
    properties:
      pinmux:
        required: true
        type: array
```

## dts/bindings/pwm/brcm,bcm2711-pwm.yaml
```yaml
# Copyright (c) 2023 Chen Xingyu <hi@xingrz.me>
# SPDX-License-Identifier: Apache-2.0

description: BCM2711 PWM

compatible: "brcm,bcm2711-pwm"

include: [pwm-controller.yaml, pinctrl-device.yaml, base.yaml]

properties:
  reg:
    required: true

  clocks:
    required: true

  "#pwm-cells":
    const: 2

pwm-cells:
- channel
- period
```

## dts/bindings/pwm/hisilicon,hi3861-pwm.yaml
```yaml
# Copyright (c) 2023 Chen Xingyu <hi@xingrz.me>
# SPDX-License-Identifier: Apache-2.0

description: Hi3861 PWM

compatible: "hisilicon,hi3861-pwm"

include: [base.yaml, pwm-controller.yaml, pinctrl-device.yaml]

properties:
  reg:
    required: true

  clocks:
    required: true

  pinctrl-0:
    required: true

  pinctrl-names:
    required: true

  prescaler:
    type: int
    default: 1500
    description: |
      Clock prescaler used for generating PWM output signals (1 to 65535)

  "#pwm-cells":
    const: 2

pwm-cells:
  - channel
  - period
```

## dts/bindings/serial/luat,air105-uart.yaml
```yaml
# Copyright (c) 2023 Chen Xingyu <hi@xingrz.me>
# SPDX-License-Identifier: Apache-2.0

description: UART driver for Luat Air105

compatible: "luat,air105-uart"

include: [uart-controller.yaml, pinctrl-device.yaml]

properties:
  reg:
    required: true

  interrupts:
    required: true

  clocks:
    required: true

  current-speed:
    required: true
```

## dts/bindings/spi/brcm,bcm2711-spi.yaml
```yaml
# Copyright (c) 2023 Chen Xingyu <hi@xingrz.me>
# SPDX-License-Identifier: Apache-2.0

description: BCM2711 SPI

compatible: "brcm,bcm2711-spi"

include: [spi-controller.yaml, pinctrl-device.yaml]

properties:
  reg:
    required: true

  interrupts:
    required: true

  clocks:
    required: true

  "#address-cells":
    const: 1

  "#size-cells":
    const: 0
```

## dts/bindings/timer/wch,ch32v-v4-systick.yaml
```yaml
# Copyright (c) 2023 Chen Xingyu <hi@xingrz.me>
# SPDX-License-Identifier: Apache-2.0

description: WCH CH32V V4 SysTick

compatible: "wch,ch32v-v4-systick"

include: base.yaml

properties:
  reg:
    required: true

  interrupts:
    required: true
```

## dts/bindings/usb/atmel,sam-udphs.yaml
```yaml
# Copyright (c) 2023 Chen Xingyu <hi@xingrz.me>
# SPDX-License-Identifier: Apache-2.0

description: |
    Atmel SAM Family USB (UDPHS) in device mode

compatible: "atmel,sam-udphs"

include:
  - name: usb-ep.yaml
  - name: pinctrl-device.yaml

properties:
  reg:
    required: true

  interrupts:
    required: true

  peripheral-id:
    type: int
    required: true
    description: peripheral ID
```

## soc/arm/luat/Kconfig
```kconfig
# Copyright (c) 2023 Chen Xingyu <hi@xingrz.me>
# SPDX-License-Identifier: Apache-2.0

config SOC_FAMILY_LUAT
	bool

if SOC_FAMILY_LUAT

config SOC_FAMILY
	string
	default "luat"

source "soc/arm/luat/*/Kconfig.soc"

endif # SOC_FAMILY_LUAT
```

## soc/arm/luat/Kconfig.defconfig
```kconfig
# Copyright (c) 2023 Chen Xingyu <hi@xingrz.me>
# SPDX-License-Identifier: Apache-2.0

if SOC_FAMILY_LUAT

source "soc/arm/luat/*/Kconfig.defconfig.series"

endif # SOC_FAMILY_LUAT
```

## soc/arm/luat/air105/Kconfig.defconfig.series
```kconfig
# Copyright (c) 2023 Chen Xingyu <hi@xingrz.me>
# SPDX-License-Identifier: Apache-2.0

if SOC_SERIES_AIR105

config SOC_SERIES
	default "air105"

config NUM_IRQS
	default 52

# Reserved for the bootloader
config FLASH_LOAD_OFFSET
	default 0x1000

endif # SOC_SERIES_AIR105
```

## soc/arm/luat/air105/Kconfig.series
```kconfig
# Copyright (c) 2023 Chen Xingyu <hi@xingrz.me>
# SPDX-License-Identifier: Apache-2.0

config SOC_SERIES_AIR105
	bool "Luat Air105 SoC"
	select ARM
	select CPU_CORTEX_M4
	select SOC_FAMILY_LUAT
	help
	  Enable support for Luat Air105 SoC.
```

## soc/arm/luat/air105/Kconfig.soc
```kconfig
# Copyright (c) 2023 Chen Xingyu <hi@xingrz.me>
# SPDX-License-Identifier: Apache-2.0

choice
	prompt "Luat Air105"
	depends on SOC_SERIES_AIR105

config SOC_AIR105
	bool "Luat Air105"

endchoice
```

## soc/riscv/luat/Kconfig.defconfig
```kconfig
# Copyright (c) 2023 Chen Xingyu <hi@xingrz.me>
# SPDX-License-Identifier: Apache-2.0

if SOC_FAMILY_LUAT

source "soc/riscv/luat/*/Kconfig.defconfig.series"

config SYS_CLOCK_HW_CYCLES_PER_SEC
	default $(dt_node_int_prop_int,/cpus/cpu@0,clock-frequency)

endif # SOC_FAMILY_LUAT
```

## soc/riscv/luat/air101/Kconfig.defconfig.series
```kconfig
# Copyright (c) 2023 Chen Xingyu <hi@xingrz.me>
# SPDX-License-Identifier: Apache-2.0

if SOC_SERIES_AIR101

config SOC_SERIES
	default "air101"

config NUM_IRQS
	default 52

# Reserved for the bootloader
config FLASH_LOAD_OFFSET
	default 0x1000

endif # SOC_SERIES_AIR101
```
