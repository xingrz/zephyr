## boards/wch/ch583m_evt/Kconfig.ch583m_evt
```kconfig
# Copyright (c) 2023-2024 Chen Xingyu <hi@xingrz.me>
# SPDX-License-Identifier: Apache-2.0

config BOARD_CH583M_EVT
	select SOC_CH583
```

## drivers/clock_control/Kconfig.air105
```kconfig
# Copyright (c) 2023 Chen Xingyu <hi@xingrz.me>
# SPDX-License-Identifier: Apache-2.0

config CLOCK_CONTROL_AIR105
	bool "Clock controller for Luat Air105"
	default y
	depends on DT_HAS_LUAT_AIR105_SYSCTRL_ENABLED
	help
	  Enable support for Air105 clock controller.
```

## drivers/clock_control/Kconfig.bcm2711
```kconfig
# Copyright (c) 2023 Chen Xingyu <hi@xingrz.me>
# SPDX-License-Identifier: Apache-2.0

config CLOCK_CONTROL_BCM2711
	bool "BCM2711 Clock Manager driver"
	default y
	depends on DT_HAS_BRCM_BCM2711_CPRMAN_ENABLED
	help
	  Enable BCM2711 Clock Manager driver.
```

## drivers/clock_control/Kconfig.ch32v
```kconfig
# Copyright (c) 2023 Chen Xingyu <hi@xingrz.me>
# SPDX-License-Identifier: Apache-2.0

config CLOCK_CONTROL_CH5XX_HCLK
	bool "WCH CH5xx HCLK clock controller"
	default y
	depends on DT_HAS_WCH_CH5XX_HCLK_ENABLED
	help
	  Enable WCH CH5xx HCLK clock controller.

config CLOCK_CONTROL_CH56X_CLKMUX
	bool "WCH CH56x clock mux controller"
	default y
	depends on DT_HAS_WCH_CH56X_CLKMUX_ENABLED
	help
	  Enable WCH CH56x clock mux controller.

config CLOCK_CONTROL_CH57X_CLKMUX
	bool "WCH CH57x clock mux controller"
	default y
	depends on DT_HAS_WCH_CH57X_CLKMUX_ENABLED
	help
	  Enable WCH CH57x clock mux controller.
```

## drivers/clock_control/Kconfig.hi3861
```kconfig
# Copyright (c) 2023 Chen Xingyu <hi@xingrz.me>
# SPDX-License-Identifier: Apache-2.0

config CLOCK_CONTROL_HI3861
	bool "Hi3861 clock controller"
	default y
	depends on DT_HAS_HISILICON_HI3861_CLDO_ENABLED
	help
	  Enable clock controller driver for Hi3861.
```

## drivers/flash/Kconfig.air105
```kconfig
# Copyright (c) 2023 Chen Xingyu <hi@xingrz.me>
# SPDX-License-Identifier: Apache-2.0

config SOC_FLASH_AIR105
	bool "Flash controller for Luat Air105"
	default y
	depends on DT_HAS_LUAT_AIR105_FLASH_CONTROLLER_ENABLED
	select FLASH_HAS_DRIVER_ENABLED
	select FLASH_HAS_PAGE_LAYOUT
	select FLASH_JESD216
	help
	  Enable support for Air105 Flash.
```

## drivers/flash/Kconfig.hi3861
```kconfig
# Copyright (c) 2023 Chen Xingyu <hi@xingrz.me>
# SPDX-License-Identifier: Apache-2.0

config SOC_FLASH_HI3861
	bool "Hi3861 SPI Flash Controller (SFC)"
	default y
	depends on DT_HAS_HISILICON_HI3861_FLASH_CONTROLLER_ENABLED
	select FLASH_HAS_DRIVER_ENABLED
	select FLASH_HAS_PAGE_LAYOUT
	select FLASH_JESD216
	help
	  Enable support for Hi3861 SPI Flash Controller (SFC).
```

## drivers/gpio/Kconfig.air105
```kconfig
# Copyright (c) 2023 Chen Xingyu <hi@xingrz.me>
# SPDX-License-Identifier: Apache-2.0

config GPIO_AIR105
	bool "GPIO driver for Luat Air105"
	default y
	depends on DT_HAS_LUAT_AIR105_GPIO_ENABLED
	help
	  Enable support for Air105 GPIO.
```

## drivers/gpio/Kconfig.ch32v
```kconfig
# Copyright (c) 2023 Chen Xingyu <hi@xingrz.me>
# SPDX-License-Identifier: Apache-2.0

config GPIO_CH56X
	bool "WCH CH56x GPIO driver"
	default y
	depends on DT_HAS_WCH_CH56X_GPIO_ENABLED
	select SHARED_INTERRUPTS
	help
	  Enable WCH CH56x GPIO driver.

config GPIO_CH57X
	bool "WCH CH57x GPIO driver"
	default y
	depends on DT_HAS_WCH_CH57X_GPIO_ENABLED
	help
	  Enable WCH CH57x GPIO driver.
```

## drivers/i2c/Kconfig.bcm2711
```kconfig
# Copyright (c) 2023 Chen Xingyu <hi@xingrz.me>
# SPDX-License-Identifier: Apache-2.0

config I2C_BCM2711
	bool "BCM2711 I2C driver"
	default y
	depends on DT_HAS_BRCM_BCM2711_I2C_ENABLED
	depends on CLOCK_CONTROL
	help
	  Enable BCM2711 I2C driver.
```

## drivers/led/Kconfig.aat3194
```kconfig
# Copyright (c) 2023 Chen Xingyu <hi@xingrz.me>
# SPDX-License-Identifier: Apache-2.0

config AAT3194
	bool "Skyworks AAT3194 LED driver"
	default y
	depends on DT_HAS_SKYWORKS_AAT3194_ENABLED
	help
	  Enable driver for Skyworks AAT3194 LED driver.

	  AAT3194 is an LED driving IC with 32 brightness ramping steps that
	  utilizes a simple single-wire control protocol.

	  This driver can also be used with other similar LED driving ICs, such
	  as AWINIC AW9364.
```

## drivers/mbox/Kconfig.sophgo
```kconfig
# Copyright (c) 2024 honglin leng <a909204013@gmail.com>
# SPDX-License-Identifier: Apache-2.0

config MBOX_SOPHGO_CV18XX
	bool "SOPHGO CV18xx Mailbox controller"
	default y
	depends on DT_HAS_SOPHGO_CV18XX_MAILBOX_ENABLED
	help
	  Enable driver for the SOPHGO CV18xx Mailbox.
```

## drivers/pinctrl/Kconfig.air105
```kconfig
# Copyright (c) 2023 Chen Xingyu <hi@xingrz.me>
# SPDX-License-Identifier: Apache-2.0

config PINCTRL_AIR105
	bool "Pin controller for Luat Air105"
	default y
	depends on DT_HAS_LUAT_AIR105_PINCTRL_ENABLED
	help
	  Enable support for Air105 Pinctrl.
```

## drivers/pinctrl/Kconfig.bcm2711
```kconfig
# Copyright (c) 2023 Chen Xingyu <hi@xingrz.me>
# SPDX-License-Identifier: Apache-2.0

config PINCTRL_BCM2711
	bool "BCM2711 Pin Controller driver"
	default y
	depends on DT_HAS_BRCM_BCM2711_PINCTRL_ENABLED
	help
	  Enable BCM2711 Pin Controller driver.
```

## drivers/pinctrl/Kconfig.sophgo
```kconfig
# Copyright (c) 2023-2024 Chen Xingyu <hi@xingrz.me>
# SPDX-License-Identifier: Apache-2.0

config PINCTRL_SOPHGO_CV180X
	bool "SOPHGO CV180x pin controller driver"
	default y
	depends on DT_HAS_SOPHGO_CV180X_PINCTRL_ENABLED
	help
	  Enables support for the SOPHGO CV180x pin controller.
```

## drivers/pwm/Kconfig.bcm2711
```kconfig
# Copyright (c) 2023 Chen Xingyu <hi@xingrz.me>
# SPDX-License-Identifier: Apache-2.0

config PWM_BCM2711
	bool "BCM2711 PWM driver"
	default y
	depends on DT_HAS_BRCM_BCM2711_PWM_ENABLED
	depends on CLOCK_CONTROL
	depends on PINCTRL
	help
	  Enable BCM2711 PWM driver.
```

## drivers/pwm/Kconfig.hi3861
```kconfig
# Copyright (c) 2023 Chen Xingyu <hi@xingrz.me>
# SPDX-License-Identifier: Apache-2.0

config PWM_HI3861
	bool "Hi3861 PWM"
	default y
	depends on DT_HAS_HISILICON_HI3861_PWM_ENABLED
	help
	  Enable support for Hi3861 PWM.
```

## drivers/pwm/Kconfig.sophgo
```kconfig
# Copyright (c) 2023-2024 Chen Xingyu <hi@xingrz.me>
# SPDX-License-Identifier: Apache-2.0

config PWM_SOPHGO_CV180X
	bool "SOPHGO CV180x PWM driver"
	default y
	depends on DT_HAS_SOPHGO_CV180X_PWM_ENABLED
	help
	  Enables support for the SOPHGO CV180x PWM.
```

## drivers/serial/Kconfig.air105
```kconfig
# Copyright (c) 2023 Chen Xingyu <hi@xingrz.me>
# SPDX-License-Identifier: Apache-2.0

config UART_AIR105
	bool "UART driver for Luat Air105"
	default y
	depends on DT_HAS_LUAT_AIR105_UART_ENABLED
	select SERIAL_HAS_DRIVER
	help
	  Enable support for Air105 UART.
```

## drivers/spi/Kconfig.bcm2711
```kconfig
# Copyright (c) 2023 Chen Xingyu <hi@xingrz.me>
# SPDX-License-Identifier: Apache-2.0

config SPI_BCM2711
	bool "BCM2711 SPI driver"
	default y
	depends on DT_HAS_BRCM_BCM2711_SPI_ENABLED
	select GPIO
	help
	  Enable BCM2711 SPI driver.
```

## drivers/spi/Kconfig.esp32
```kconfig
# ESP32 SPI configuration

# Copyright (c) 2020 Espressif Systems (Shanghai) Co., Ltd.
# SPDX-License-Identifier: Apache-2.0

menuconfig ESP32_SPIM
	bool "ESP32 SPI Master driver"
	depends on SOC_ESP32 || SOC_ESP32S2 || SOC_ESP32C3
	default y
	help
	  Enables support for ESP32 SPI Master driver.

if ESP32_SPIM

config SPI_ESP32_INTERRUPT
	bool "ESP32 SPI interrupt mode"
	help
	  Enables interrupt support for ESP32 SPI driver.

config SPI_ESP32_IOMUX
	bool "ESP32 SPI IO MUX mode"
	help
	  Routes SPI pins through IO MUX, instead of GPIO matrix. This enables the
	  SPI driver to work in a clock speed higher than 20 MHz. Only available for
	  some specific pins.

endif # ESP32_SPIM
```

## dts/bindings/clock/brcm,bcm2711-cprman.yaml
```yaml
# Copyright (c) 2023 Chen Xingyu <hi@xingrz.me>
# SPDX-License-Identifier: Apache-2.0

description: BCM2711 Clock Manager

compatible: "brcm,bcm2711-cprman"

include: [clock-controller.yaml, base.yaml]

properties:
  reg:
    required: true

  clocks:
    required: true

  "#clock-cells":
    const: 2

clock-cells:
  - config
  - frequency
```

## dts/bindings/clock/hisilicon,hi3861-cldo.yaml
```yaml
# Copyright (c) 2023 Chen Xingyu <hi@xingrz.me>
# SPDX-License-Identifier: Apache-2.0

description: Hi3861 clock controller

compatible: "hisilicon,hi3861-cldo"

include: [clock-controller.yaml, base.yaml]

properties:
  reg:
    required: true

  clocks:
    required: true

  "#clock-cells":
    const: 2

clock-cells:
  - clock-reg
  - freq-sel
```
